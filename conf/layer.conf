## conf/layer.conf
```bitbake
# We have a conf and classes directory, add to BBPATH
BBPATH .= ":${LAYERDIR}"

# We have recipes-* directories, add to BBFILES
BBFILES += "${LAYERDIR}/recipes-*/*/*.bb \
	${LAYERDIR}/recipes-*/*/*.bbappend"

BBFILE_COLLECTIONS += "raspberry"
BBFILE_PATTERN_raspberry  = "^${LAYERDIR}/"
BBFILE_PRIORITY_raspberry = "10"

LAYERSERIES_COMPAT_raspberry = "kirkstone"

# Set variable to get the location of the layer
RASPBERRYPI_BASE := '${LAYERDIR}'
```

## conf/machine/raspberrypi3.conf
```bitbake
#@TYPE: Machine
#@NAME: Raspberry Pi 3 Development Board
#@DESCRIPTION: Machine configuration for the Raspberry Pi 3 in 64 bit mode

require conf/machine/include/arm/armv8a/tune-cortexa53.inc
include conf/machine/raspberrypi.inc

MACHINE_FEATURES += "\
    pci \
    alsa \
    screen \
    touchscreen \
"

MACHINE_FEATURES_BACKFILL_CONSIDERED = "rtc"

MACHINE_EXTRA_RRECOMMENDS += " \
    linux-firmware-rpidistro-bcm43456 \
    linux-firmware-rpidistro-bcm43430 \
    linux-firmware-rpidistro-bluez-bcm43430a1-hcd \
    linux-firmware-rpidistro-bcm43455 \
    linux-firmware-rpidistro-bluez-bcm4345c0-hcd \
    linux-firmware-rpidistro-bcm43436 \
    linux-firmware-rpidistro-bcm43436s \
    linux-firmware-rpidistro-bluez-bcm43430b0-hcd \
"

KERNEL_DEVICETREE += " \
    broadcom/bcm2710-rpi-3-b.dtb \
    broadcom/bcm2710-rpi-3-b-plus.dtb \
    broadcom/bcm2837-rpi-3-b.dtb \
    broadcom/bcm2837-rpi-3-a-plus.dtb \
"

KERNEL_IMAGE ?= "kernel8.img"
SERIAL_CONSOLES = "115200;ttyS0"
SERIAL_CONSOLES_CHECK = "${SERIAL_CONSOLES}"
```

## wic/raspberrypi.wks
```
# short-description: Create an image for Raspberry Pi.
# long-description: Creates a partitioned SD card image for Raspberry Pi.

# boot partition (20M)
part /boot --source bootimg-partition --ondisk mmcblk0 --fstype=vfat --label boot --active --align 4096 --size 20

# root partition (yocto defined)
part / --source rootfs --ondisk mmcblk0 --fstype=ext4 --label root --align 4096

# data partition (4G)
part /data --ondisk mmcblk0 --fstype=ext4 --label data --align 4096 --size 4096
```
